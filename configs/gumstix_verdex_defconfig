## configs/gumstix_verdex_defconfig
```kconfig
BR2_arm=y
BR2_iwmmxt=y
BR2_DL_DIR="$(TOPDIR)/../buildroot-downloads"
BR2_GLOBAL_PATCH_DIR="$(TOPDIR)/board/gumstix-verdex/global-patches"
BR2_KERNEL_HEADERS_VERSION=y
BR2_DEFAULT_KERNEL_VERSION="2.6.21"
BR2_GCC_VERSION_4_3_X=y
BR2_TOOLCHAIN_BUILDROOT_CXX=y
BR2_TARGET_GENERIC_HOSTNAME="gumstix-rc"
BR2_TARGET_GENERIC_ISSUE="Welcome to Gumstix-RC"
BR2_LINUX_KERNEL=y
BR2_LINUX_KERNEL_SAME_AS_HEADERS=y
BR2_LINUX_KERNEL_PATCH="board/gumstix-verdex/linux-2.6.21-patches"
BR2_LINUX_KERNEL_USE_CUSTOM_CONFIG=y
BR2_LINUX_KERNEL_CUSTOM_CONFIG_FILE="board/gumstix-verdex/linux-2.6.21.config"
BR2_PACKAGE_LRZSZ=y
BR2_TARGET_ROOTFS_TAR_GZIP=y
```
